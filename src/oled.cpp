/**
 * oled.cpp - Minimal SSD1306 (128x64, I2C addr 0x3C) driver.
 * Owned exclusively by DisplayTask (Section 26): no other module
 * includes this file, so the I2C bus and framebuffer have a single
 * user and need no display mutex.
 */
#include "stm32f1xx_hal.h"
#include "oled.h"
#include <string.h>

#define OLED_ADDR (0x3C << 1) /* HAL wants 8-bit address */
#define FB_W 128
#define FB_H 64
#define FONT_W 5
#define FONT_H 8
#define OLED_DATA_CHUNK 64

static uint8_t fb[FB_H / 8][FB_W];
static bool bus_initialized = false;
static bool oled_ok = true;
static uint8_t oled_error = 0;

static inline void i2c_delay(void)
{
    for (volatile uint32_t i = 0; i < 6; i++) {
        __NOP();
    }
}

static inline void sda_high(void) { GPIOB->BSRR = GPIO_PIN_7; }
static inline void sda_low(void)  { GPIOB->BRR = GPIO_PIN_7; }
static inline void scl_high(void) { GPIOB->BSRR = GPIO_PIN_6; }
static inline void scl_low(void)  { GPIOB->BRR = GPIO_PIN_6; }

static void i2c_start(void)
{
    sda_high(); scl_high(); i2c_delay();
    sda_low();  i2c_delay(); scl_low();  i2c_delay();
}

static void i2c_stop(void)
{
    sda_low(); i2c_delay(); scl_high(); i2c_delay(); sda_high(); i2c_delay();
}

static bool i2c_write_byte(uint8_t value)
{
    for (uint8_t bit = 0; bit < 8; bit++) {
        (value & 0x80U) ? sda_high() : sda_low();
        value <<= 1;
        i2c_delay(); scl_high(); i2c_delay(); scl_low(); i2c_delay();
    }
    sda_high(); i2c_delay(); scl_high(); i2c_delay();
    bool acknowledged = (GPIOB->IDR & GPIO_PIN_7) == 0;
    scl_low(); i2c_delay();
    return acknowledged;
}

static bool send_data(const uint8_t *data, uint16_t count)
{
    i2c_start();
    bool acknowledged = i2c_write_byte((uint8_t)OLED_ADDR);
    acknowledged = i2c_write_byte(0x40) && acknowledged;
    for (uint16_t i = 0; i < count; i++) {
        acknowledged = i2c_write_byte(data[i]) && acknowledged;
    }
    i2c_stop();
    return acknowledged;
}

static void cmd(uint8_t c)
{
    i2c_start();
    bool acknowledged = i2c_write_byte((uint8_t)OLED_ADDR);
    acknowledged = i2c_write_byte(0x00) && acknowledged;
    acknowledged = i2c_write_byte(c) && acknowledged;
    i2c_stop();
    if (!acknowledged) {
        oled_ok = false;
        oled_error = 2;
    }
}

static void flush(void)
{
    static uint8_t packet[OLED_DATA_CHUNK];

    cmd(0x21); /* column address window */
    cmd(0x00);
    cmd(FB_W - 1);
    cmd(0x22); /* page address window */
    cmd(0x00);
    cmd((FB_H / 8) - 1);

    for (uint8_t page = 0; page < FB_H / 8; page++) {
        for (uint16_t column = 0; column < FB_W; column += OLED_DATA_CHUNK) {
            memcpy(packet, &fb[page][column], OLED_DATA_CHUNK);
            if (!send_data(packet, OLED_DATA_CHUNK)) {
                oled_ok = false; oled_error = 3;
            }
        }
    }
}

/* 5x8 ASCII font, chars 32..126 */
static const uint8_t font5x8[][5] = {
    {0x00,0x00,0x00,0x00,0x00}, {0x00,0x00,0x5F,0x00,0x00}, {0x00,0x07,0x00,0x07,0x00}, {0x14,0x7F,0x14,0x7F,0x14},
    {0x24,0x2A,0x7F,0x2A,0x12}, {0x23,0x13,0x08,0x64,0x62}, {0x36,0x49,0x55,0x22,0x50}, {0x00,0x05,0x03,0x00,0x00},
    {0x00,0x1C,0x22,0x41,0x00}, {0x00,0x41,0x22,0x1C,0x00}, {0x14,0x08,0x3E,0x08,0x14}, {0x08,0x08,0x3E,0x08,0x08},
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    {0x00,0x00,0x7F,0x00,0x00}, {0x00,0x41,0x36,0x08,0x00}, {0x10,0x08,0x08,0x10,0x08}, {0x78,0x46,0x41,0x46,0x78}
};

bool oled_init(void)
{
    bus_initialized = true;
    oled_ok = true;
    oled_error = 0;

    // Initialize PB6 (SCL) and PB7 (SDA) as Output Open-Drain for software I2C
    __HAL_RCC_GPIOB_CLK_ENABLE();
    GPIO_InitTypeDef gpio = {0};
    gpio.Pin = GPIO_PIN_6 | GPIO_PIN_7;
    gpio.Mode = GPIO_MODE_OUTPUT_OD;
    gpio.Pull = GPIO_PULLUP;
    gpio.Speed = GPIO_SPEED_FREQ_HIGH;
    HAL_GPIO_Init(GPIOB, &gpio);

    i2c_start();
    bool ack = i2c_write_byte((uint8_t)OLED_ADDR);
    i2c_stop();
    if (!ack) {
        oled_ok = false;
        oled_error = 1;
        return false;
    }

    cmd(0xAE); /* display off */
    cmd(0x20); /* memory mode */
    cmd(0x00); /* horizontal addressing */
    cmd(0xC8); /* COM scan inc */
    cmd(0xA1); /* segment remap */
    cmd(0x8D); /* charge pump */
    cmd(0x14); /* enable */
    cmd(0xAF); /* display on */

    memset(fb, 0, sizeof(fb));
    flush();

    return oled_ok;
}

uint8_t oled_error_stage(void)
{
    return oled_error;
}

void oled_clear(void)
{
    memset(fb, 0, sizeof(fb));
    flush();
}

void oled_show_text(uint8_t col, uint8_t page, const char *text)
{
    if (!bus_initialized) return;

    while (*text && col < FB_W - FONT_W) {
        char c = *text++;
        if (c >= 32 && c <= 126) {
            const uint8_t *glyph = font5x8[c - 32];
            for (uint8_t i = 0; i < FONT_W; i++) {
                fb[page][col + i] = glyph[i];
            }
        }
        col += FONT_W + 1;
    }
    flush();
}